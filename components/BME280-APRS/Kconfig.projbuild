## components/BME280-APRS/Kconfig.projbuild
```kconfig
menu "BME280 APRS Configuration"

config BME280_EXISTS
    bool "BME280 exists"
    default n
    help
	BME280 sensor exists or not.

config BME280_INTERVAL
    int "BME280 interval in sec."
    depends on BME280_EXISTS
    range 30 3600
    default 600

config BME280_MYCALL
    string "BME280 source callsign"
    depends on BME280_EXISTS
    default "NOCALL"


config BME280_DSTCALL
    string "BME280 distnation callsign"
    depends on BME280_EXISTS
    default "BEACON"

config BME280_RPTCALL
    string "BME280 digipeater callsign"
    depends on BME280_EXISTS
    default "WIDE1-1"


config BME280_LAT
    string "BME280 latitude"
    depends on BME280_EXISTS
    default "3539.20N"
    help
	ex. 3539.20N

config BME280_LON
    string "BME280 longitude"
    depends on BME280_EXISTS
    default "13927.73E"
    help
	ex. 13927.73E

endmenu
```

## components/bk4802/Kconfig.projbuild
```kconfig
menu "BK4802 Configuration"

config BK4802_TX_POWER
    int "BK4802 TX Power 0-7, (0:-40dBm .. 7:12dBm)"
    default 7
    range 0 7

endmenu
```

## components/m5stickc/Kconfig.projbuild
```kconfig
menu "M5StickC Plus configuration"

choice
    prompt "Battery charge voltage"
    default AXP192_CHG_VOLTAGE_V41

config AXP192_CHG_VOLTAGE_V41
    bool "Battery charge voltage 4.1V"

config AXP192_CHG_VOLTAGE_V415
    bool "Battery charge voltage 4.15V"

config AXP192_CHG_VOLTAGE_V42
    bool "Battery charge voltage 4.2V"

endchoice

choice
    prompt "Battery charge stop current"
    default AXP192_CHG_10PERCENT

config AXP192_CHG_10PERCENT
    bool "Battery charge stop current 10%"
    
config AXP192_CHG_15PERCENT
    bool "Battery charge stop current 15%"

endchoice

config LCD_OFF_TIME_VBUS
    int "LCD off time (min.) powered by USB"
    default 10
    range 0 127

config LCD_OFF_TIME_BATT
    int "LCD off time (min.) powered by battery"
    default 2
    range 0 127

config TIME_ZONE
    string "Time zone"
    default "JST-9"
    help
	Assume RTC BM8563 time is local time.
	
config BATTERY_INFO
    bool "output battery information to serial every minutes"
    default false

endmenu
```

## main/Kconfig.projbuild
```kconfig
menu "ESP32TNC Configuration"

choice
    prompt "Hardware type"
    default M5STICKC

config M5STICKC
    bool "M5StickC Plus"

config M5ATOM
    bool "M5Atom Lite/Matrix"

config FX25TNCR1
    bool "FX.25 KISS TNC rev.1 (TCM3105 version)"
        
config FX25TNCR2
    bool "FX.25 KISS TNC rev.2 (SMD version)"

config FX25TNCR3
    bool "FX.25 KISS TNC rev.3 (6ports capable version)"

config FX25TNCR4
    bool "FX.25 KISS TNC rev.4 (Software modem and TCM3105 version)"
    
endchoice

config M5STICKC_AUDIO
    bool "packet input/output using internal MIC and SP"
    default "n"
    depends on M5STICKC

config M5ATOM_PORTS
    int "Configure number of ports"
    default 1
    range 1 2
    depends on M5ATOM

config FX25TNCR3_PORTS
    int "Configure number of ports"
    default 2
    range 1 6
    depends on FX25TNCR3

config GPIO_RXD_PIN
    int "GPIO No. which connected to TCM3105 RXD pin"
    default 39
    range 0 39
    depends on FX25TNCR1

config GPIO_CDT_PIN
    int "GPIO No. which connected to TCM3105 CDT pin"
    default 36
    range 0 39
    depends on FX25TNCR1
    
config GPIO_TXD_PIN
    int "GPIO No. which connected to TCM3105 TXD pin"
    default 12
    range 0 39
    depends on FX25TNCR1

config GPIO_PTT_PIN
    int "GPIO No. which connected to the transmitter PTT"
    default 15
    range 0 39
    depends on FX25TNCR1

config GPIO_LED_PIN
    int "GPIO No. which connected to CDT LED"
    default 2
    range 0 39
    depends on FX25TNCR1

config ENABLE_TCM3105
    bool "enable TCM3105 modem chip"
    default "y"
    depends on FX25TNCR4
    
if FX25TNCR1 || (FX25TNCR4 && ENABLE_TCM3105)
config TCM3105_ADC
    bool "use ADC to get RXD state"
    default "y"
endif

config TEXT_MODE
    bool "Enable text mode instead of KISS protocol"
    default "y"
    help
    Serial output is changed for human readable format.

config USE_WIFI
    bool "Enable WiFi"
    default "n"
    help
	TNC will connect to WiFi AP at startup.

config ESP_WIFI_SSID
    string "WiFi SSID"
    default "myssid"
    depends on USE_WIFI
    help
	SSID (network name) for the example to connect to.

config ESP_WIFI_PASSWORD
    string "WiFi Password"
    default "mypassword"
    depends on USE_WIFI
    help
	WiFi password (WPA or WPA2) for the example to use.

config TCP_PORT
    int "TCP port for KISS connection"
    default 8001
    range 0 65535
    depends on USE_WIFI

config UDP_PORT
    int "UDP port for KISS connection"
    default 8001
    range 0 65535
    depends on USE_WIFI

config KISS_TXDELAY
    int "KISS TXDELAY, 10 ms units"
    default 50
    range 0 255

config KISS_P
    int "KISS persistence parameter, P"
    default 63
    range 0 255
    help
	P = p * 256 - 1

config KISS_SLOTTIME
    int "KISS SlotTime, 10 ms units"
    default 10
    range 1 255

config KISS_FULLDUPLEX
    bool "full duplex if true"
    default "n"

config FX25_ENABLE
    bool "Enable FX.25 Forward Error Correction"
    default "y"

choice
    prompt "FX.25 number of parity symbols"
    default FX25_PARITY_16
    depends on FX25_ENABLE
    help
        Number of parity symbols of Reed-Solomon code

config FX25_PARITY_0
    bool "AX.25"

config FX25_PARITY_16
    bool "FX.25 16 parity"

config FX25_PARITY_32
    bool "FX.25 32 parity"

config FX25_PARITY_64
    bool "FX.25 64 parity"

endchoice

config BEACON
    bool "Enable beacon"
    default "n"
    help
	Enable beacon packet transmittion.

config BEACON_CALLSIGN
    string "Source address of beacon packet"
    default "NOCALL"
    depends on BEACON

config BEACON_INTERVAL
    int "Interval of beacon packet"
    default 600
    range 30 3600
    depends on BEACON
     
config BEACON_TEXT
    string "Beacon text"
    default "Beacon packet of ESP32TNC"
    depends on BEACON

config DEBUG
    bool "output debug message"
    default "n"

config FX25_STAT
    bool "sending FX.25 FEC statistics information to the air as AX.25 packet"
    default "n"
    depends on FX25_ENABLE

config FX25_STAT_CALLSIGN
    string "Source address of FX.25 FEC statistics packet"
    default "NOCALL"
    depends on FX25_STAT

endmenu
```
